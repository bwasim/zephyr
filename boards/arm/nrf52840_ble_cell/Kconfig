## boards/arm/nrf52840_ble_cell/Kconfig
```kconfig
# nRF52840 BLE Cell board configuration

# Copyright (c) 2020 Bilal Wasim
# SPDX-License-Identifier: Apache-2.0

config BOARD_ENABLE_DCDC
	bool "Enable DCDC mode"
	select SOC_DCDC_NRF52X
	default y
	depends on BOARD_NRF52840_BLE_CELL
```

## boards/arm/nrf52840_ble_cell/Kconfig.board
```kconfig
# nRF52840 BLE Cell board configuration

# Copyright (c) 2020 Bilal Wasim
# SPDX-License-Identifier: Apache-2.0

config BOARD_NRF52840_BLE_CELL
	bool "nRF52840 based BLE Cell"
	depends on SOC_NRF52840_QIAA
```

## boards/arm/nrf52840_ble_cell/Kconfig.defconfig
```kconfig
# nRF52840 BLE Cell board configuration

# Copyright (c) 2020 Bilal Wasim
# SPDX-License-Identifier: Apache-2.0

if BOARD_NRF52840_BLE_CELL

config BOARD
	default "nrf52840_ble_cell"

if USB

config USB_NRFX
	default y

config USB_DEVICE_STACK
	default y

endif # USB

config BT_CTLR
	default BT

endif # BOARD_NRF52840_BLE_CELL
```

## boards/arm/nrf52840_ble_cell/nrf52840_ble_cell_defconfig
```kconfig
# SPDX-License-Identifier: Apache-2.0

CONFIG_SOC_SERIES_NRF52X=y
CONFIG_SOC_NRF52840_QIAA=y
CONFIG_BOARD_NRF52840_BLE_CELL=y

# Enable MPU
CONFIG_ARM_MPU=y

# Enable hardware stack protection
CONFIG_HW_STACK_PROTECTION=y

# Enable GPIO
CONFIG_GPIO=y

# Enable uart driver
CONFIG_SERIAL=y

# Enable console
CONFIG_CONSOLE=y
CONFIG_UART_CONSOLE=y
CONFIG_RTT_CONSOLE=n
CONFIG_USE_SEGGER_RTT=n

# Additional board options
CONFIG_GPIO_AS_PINRESET=y

# Quectel BG9x modem
CONFIG_MODEM=y
CONFIG_MODEM_SHELL=y
CONFIG_MODEM_QUECTEL_BG9X=y

# Networking (required for modem)
CONFIG_NETWORKING=y
CONFIG_NET_NATIVE=n
CONFIG_NET_IPV4=y
CONFIG_NET_IPV6=n
CONFIG_NET_SOCKETS=y
CONFIG_NET_SOCKETS_OFFLOAD=y

# NRF5 Temp Sensor.
CONFIG_SENSOR=y
CONFIG_TEMP_NRF5=y

# Logging
CONFIG_LOG=y
CONFIG_LOG_STRDUP_BUF_COUNT=16
```

## drivers/sensor/bq2589x/Kconfig
```kconfig
# Copyright (c) 2020 Analog Life LLC
#
# SPDX-License-Identifier: Apache-2.0

config BQ2589X
	bool "TI BQ2589x Battery Driver"
	depends on I2C
	help
	  Battery Driver for TI BQ2589x.
```

## drivers/sensor/sps30/Kconfig
```kconfig
# Sensirion SPS30 Particulate Matter Sensor configuration options

# Copyright (c) 2020 Bilal Wasim
# SPDX-License-Identifier: Apache-2.0

config SENSIRION_SPS30
	bool "SPS30 Particulate Matter Sensor"
	depends on I2C && HAS_DTS_I2C
	help
	  Enable driver for Sensirion SPS30 Particulate Matter Sensor.
```

## dts/bindings/modem/quectel,bg9x.yaml
```yaml
# Copyright (c) 2020, Bilal Wasim
# SPDX-License-Identifier: Apache-2.0

description: quectel BG9x modem

compatible: "quectel,bg9x"

include: uart-device.yaml

properties:
    label:
      required: true

    mdm-power-gpios:
      type: phandle-array
      required: true

    mdm-reset-gpios:
      type: phandle-array
      required: true
```

## dts/bindings/sensor/sensirion,sps30.yaml
```yaml
# Copyright (c) 2020, Bilal Wasim
# SPDX-License-Identifier: Apache-2.0

description: Sensirion SPS30 Particulate Matter Sensor

compatible: "sensirion,sps30"

include: i2c-device.yaml
```

## dts/bindings/sensor/ti,bq2589x.yaml
```yaml
#
# Copyright (c) 2020 Analog Life LLC
#
# SPDX-License-Identifier: Apache-2.0
#

description: Texas Instruments BQ2589x Battery Controller

compatible: "ti,bq2589x"

include: i2c-device.yaml

properties:
    charge_voltage:
      type: int
      required: true
      description: Battery Charge Voltage(mV)

    charge_current:
      type: int
      required: true
      description: Battery Charge Current(mAh)

    term_current:
      type: int
      required: true
      description: Battery Terminate Current(mAh)

    enable_auto_dpdm:
      type: boolean
      description: Enable Auto DPDM

    enable_termination:
      type: boolean
      description: Enable Termination

    enable_ico:
      type: boolean
      description: Enable ICO

    use_absolute_vindpm:
      type: boolean
      description: Use Absolute VINdPM
```
